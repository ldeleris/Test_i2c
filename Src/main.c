/**
  ******************************************************************************
  * File Name          : main.c
  * Description        : Main program body
  ******************************************************************************
  *
  * COPYRIGHT(c) 2017 STMicroelectronics
  *
  * Redistribution and use in source and binary forms, with or without modification,
  * are permitted provided that the following conditions are met:
  *   1. Redistributions of source code must retain the above copyright notice,
  *      this list of conditions and the following disclaimer.
  *   2. Redistributions in binary form must reproduce the above copyright notice,
  *      this list of conditions and the following disclaimer in the documentation
  *      and/or other materials provided with the distribution.
  *   3. Neither the name of STMicroelectronics nor the names of its contributors
  *      may be used to endorse or promote products derived from this software
  *      without specific prior written permission.
  *
  * THIS SOFTWARE IS PROVIDED BY THE COPYRIGHT HOLDERS AND CONTRIBUTORS "AS IS"
  * AND ANY EXPRESS OR IMPLIED WARRANTIES, INCLUDING, BUT NOT LIMITED TO, THE
  * IMPLIED WARRANTIES OF MERCHANTABILITY AND FITNESS FOR A PARTICULAR PURPOSE ARE
  * DISCLAIMED. IN NO EVENT SHALL THE COPYRIGHT HOLDER OR CONTRIBUTORS BE LIABLE
  * FOR ANY DIRECT, INDIRECT, INCIDENTAL, SPECIAL, EXEMPLARY, OR CONSEQUENTIAL
  * DAMAGES (INCLUDING, BUT NOT LIMITED TO, PROCUREMENT OF SUBSTITUTE GOODS OR
  * SERVICES; LOSS OF USE, DATA, OR PROFITS; OR BUSINESS INTERRUPTION) HOWEVER
  * CAUSED AND ON ANY THEORY OF LIABILITY, WHETHER IN CONTRACT, STRICT LIABILITY,
  * OR TORT (INCLUDING NEGLIGENCE OR OTHERWISE) ARISING IN ANY WAY OUT OF THE USE
  * OF THIS SOFTWARE, EVEN IF ADVISED OF THE POSSIBILITY OF SUCH DAMAGE.
  *
  ******************************************************************************
  */
/* Includes ------------------------------------------------------------------*/
#include "main.h"
#include "stm32l4xx_hal.h"

/* USER CODE BEGIN Includes */

/* USER CODE END Includes */

/* Private variables ---------------------------------------------------------*/
I2C_HandleTypeDef hi2c3;

/* USER CODE BEGIN PV */
/* Private variables ---------------------------------------------------------*/

uint16_t address = 0x3C << 1;
// the memory buffer for the LCD

static char buffer[128 * 64 / 8] = {
0x00, 0x00, 0x00, 0x00, 0x00, 0x00, 0x00, 0x00, 0x00, 0x00, 0x00, 0x00, 0x00, 0x00, 0x00, 0x00,
0x00, 0x00, 0x00, 0x00, 0x00, 0x00, 0x00, 0x00, 0x00, 0x00, 0x00, 0x00, 0x00, 0x00, 0x00, 0x00,
0x00, 0x00, 0x00, 0x00, 0x00, 0x00, 0x00, 0x00, 0x00, 0x00, 0x00, 0x00, 0x00, 0x00, 0x00, 0x00,
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0x00, 0x00, 0x00, 0x00, 0x00, 0x00, 0x00, 0x00, 0x00, 0x00, 0x00, 0x00, 0x00, 0x00, 0x00, 0x00
};

/* USER CODE END PV */

/* Private function prototypes -----------------------------------------------*/
void SystemClock_Config(void);
void Error_Handler(void);
static void MX_GPIO_Init(void);
static void MX_I2C3_Init(void);

/* USER CODE BEGIN PFP */
/* Private function prototypes -----------------------------------------------*/

/* USER CODE END PFP */

/* USER CODE BEGIN 0 */

/* USER CODE END 0 */

int main(void)
{

  /* USER CODE BEGIN 1 */


  /* USER CODE END 1 */

  /* MCU Configuration----------------------------------------------------------*/

  /* Reset of all peripherals, Initializes the Flash interface and the Systick. */
  HAL_Init();

  /* Configure the system clock */
  SystemClock_Config();

  /* Initialize all configured peripherals */
  MX_GPIO_Init();
  MX_I2C3_Init();
  LED_Init();

  /* USER CODE BEGIN 2 */
  LCD_Init();
  /* USER CODE END 2 */

  /* Infinite loop */
  /* USER CODE BEGIN WHILE */
  int i = 0;
  int j = 0;

  while (1)
  {
  /* USER CODE END WHILE */

  /* USER CODE BEGIN 3 */
	  if (HAL_I2C_IsDeviceReady(&hi2c3, (uint16_t) address, 3, 1000) == HAL_OK)
	  {
		  LED_On();
		  LCD_dim(0);
		  //i = (~i) & 0x01;
		  if (j == 0)
		  {
			  LCD_display();
			  //LCD_startscrollright(0x00, 0x0F);
		  }
		  j++;
	  }
	  else
	  {
		  LED_Off();
	  }

	  if (j == 1)
	  {
		  LCD_clearDisplay();
		  //int y = 20;
		  for (int x=20;x<100;x++)
		  {
			  for (int y=20; y<40; y++)
			  {
				  LCD_drawPixel(x,y,WHITE);
			  }


		  }
		  i++;

		  j = 0;
	  }


	  HAL_Delay(20);


  }
  /* USER CODE END 3 */

}


void LCD_display(void)
{
  char data[7] = {0x00, 0x21,
		  	  	  0x00,
				  0x7F,
				  0x22,
				  0x00,
				  0x07};
  char temp[128*64/8];

  for (int i = 0; i < 7; i++)
  {
	  temp[i] = data[i];
  }
  HAL_I2C_Master_Transmit(&hi2c3, (uint16_t) address, (uint8_t *) temp, 7, 1000);
  temp[0] = 0x40;
  for (int i=1; i<(128*64/8); i++)
  {
   	temp[i] = buffer[i];
  }
  HAL_I2C_Master_Transmit(&hi2c3, (uint16_t) address, (uint8_t *) temp, 128*64/8, 1000);

/*
  for (int i=0; i<(128*64/8); i++)
  {
      // send a bunch of data in one xmission
      temp[0] = 0x40;
      //HAL_I2C_Master_Transmit(&hi2c3, (uint16_t) address, (uint8_t *) data, 1, 1000);
      for (int x=1; x<17; x++)
      {
    	temp[x] = buffer[i];
    	HAL_I2C_Master_Transmit(&hi2c3, (uint16_t) address, (uint8_t *) temp, 17, 1000);
        i++;
      }
      i--;
  }
 */
 }

// the most basic function, set a single pixel
void LCD_drawPixel(int x, int y, int color)
{
  if ((x < 0) || (x >= 128) || (y < 0) || (y >= 64))
    return;

  // check rotation, move pixel around if necessary
//  switch (getRotation()) {
//  case 1:
//    ssd1306_swap(x, y);
//    x = WIDTH - x - 1;
//    break;
//  case 2:
    x = 128 - x - 1;
    y = 64 - y - 1;
//    break;
//  case 3:
//    ssd1306_swap(x, y);
//    y = HEIGHT - y - 1;
//    break;
//  }

  // x is which column
    switch (color)
    {
      case WHITE:   buffer[x+ (y/8)*128] |=  (1 << (y&7)); break;
      case BLACK:   buffer[x+ (y/8)*128] &= ~(1 << (y&7)); break;
      case INVERSE: buffer[x+ (y/8)*128] ^=  (1 << (y&7)); break;
    }

}

// clear everything
void LCD_clearDisplay(void)
{
  memset(buffer, 0, (128*64/8));
}

void LCD_Invert(char i)
{
	char data[2] = {0x00, 0x00};
	data[1] = i==1?0xA7:0xA6;

	HAL_I2C_Master_Transmit(&hi2c3, (uint16_t) address, (uint8_t *) data, 2, 1000);
}

void LCD_Init(void)
{
	  // Init sequence
	  char data[] = {0xAE,0xD5, 0x80, 0xA8,
		         0x3F, 0xD3, 0x00, 0x40,
				 0x8D, 0x14, 0x20, 0x00,
				 0xA0 | 0x01, 0xC8, 0xDA,
				 0x12, 0x81, 0xCF, 0xd9,
				 0xF1, 0xDB, 0x40, 0xA4,
				 0xA6, 0x2E, 0xAF};
	  char temp[2] = {0x00, 0x00};

	  for (int i=0; i<26; i++)
	  {
		  temp[1] = data[i];
		  HAL_I2C_Master_Transmit(&hi2c3, (uint16_t) address, (uint8_t *) temp, 2, 1000);
	  }
}

// Dim the display
// dim = true: display is dimmed
// dim = false: display is normal
void LCD_dim(char dim)
{
	char temp[3] = {0x00, 0x81, 0x00};

	if (dim)
	{
		temp[2] = 0x00; // Dimmed display
	}
	else
	{
		temp[2] = 0x9F;
	}
	// the range of contrast to too small to be really useful
	// it is useful to dim the display
	HAL_I2C_Master_Transmit(&hi2c3, (uint16_t) address, (uint8_t *) temp, 3, 1000);
}

// startscrollright
// Activate a right handed scroll for rows start through stop
// Hint, the display is 16 rows tall. To scroll the whole display, run:
// display.scrollright(0x00, 0x0F)
void LCD_startscrollright(char start, char stop)
{
	char data[] = {0x26, 0x00, start, 0x07, stop, 0x00, 0xFF, 0x2F};
	char temp[2] = {0x00, 0x00};
	for (int i=0; i<8; i++)
	{
	  temp[1] = data[i];
	  HAL_I2C_Master_Transmit(&hi2c3, (uint16_t) address, (uint8_t *) temp, 2, 1000);
	}
}

// startscrollleft
// Activate a right handed scroll for rows start through stop
// Hint, the display is 16 rows tall. To scroll the whole display, run:
// display.scrollright(0x00, 0x0F)
void LCD_startscrollleft(char start, char stop)
{
	char data[] = {0x27, 0x00, start, 0x00, stop, 0x00, 0xFF, 0x2F};
	char temp[2] = {0x00, 0x00};
	for (int i=0; i<8; i++)
	{
	  temp[1] = data[i];
	  HAL_I2C_Master_Transmit(&hi2c3, (uint16_t) address, (uint8_t *) temp, 2, 1000);
	}
}

/** System Clock Configuration
*/
void SystemClock_Config(void)
{

  RCC_OscInitTypeDef RCC_OscInitStruct;
  RCC_ClkInitTypeDef RCC_ClkInitStruct;
  RCC_PeriphCLKInitTypeDef PeriphClkInit;

    /**Initializes the CPU, AHB and APB busses clocks 
    */
  RCC_OscInitStruct.OscillatorType = RCC_OSCILLATORTYPE_HSI;
  RCC_OscInitStruct.HSIState = RCC_HSI_ON;
  RCC_OscInitStruct.HSICalibrationValue = 16;
  RCC_OscInitStruct.PLL.PLLState = RCC_PLL_ON;
  RCC_OscInitStruct.PLL.PLLSource = RCC_PLLSOURCE_HSI;
  RCC_OscInitStruct.PLL.PLLM = 1;
  RCC_OscInitStruct.PLL.PLLN = 10;
  RCC_OscInitStruct.PLL.PLLP = RCC_PLLP_DIV7;
  RCC_OscInitStruct.PLL.PLLQ = RCC_PLLQ_DIV2;
  RCC_OscInitStruct.PLL.PLLR = RCC_PLLR_DIV2;
  if (HAL_RCC_OscConfig(&RCC_OscInitStruct) != HAL_OK)
  {
    Error_Handler();
  }

    /**Initializes the CPU, AHB and APB busses clocks 
    */
  RCC_ClkInitStruct.ClockType = RCC_CLOCKTYPE_HCLK|RCC_CLOCKTYPE_SYSCLK
                              |RCC_CLOCKTYPE_PCLK1|RCC_CLOCKTYPE_PCLK2;
  RCC_ClkInitStruct.SYSCLKSource = RCC_SYSCLKSOURCE_PLLCLK;
  RCC_ClkInitStruct.AHBCLKDivider = RCC_SYSCLK_DIV1;
  RCC_ClkInitStruct.APB1CLKDivider = RCC_HCLK_DIV1;
  RCC_ClkInitStruct.APB2CLKDivider = RCC_HCLK_DIV1;

  if (HAL_RCC_ClockConfig(&RCC_ClkInitStruct, FLASH_LATENCY_4) != HAL_OK)
  {
    Error_Handler();
  }

  PeriphClkInit.PeriphClockSelection = RCC_PERIPHCLK_I2C3;
  PeriphClkInit.I2c3ClockSelection = RCC_I2C3CLKSOURCE_PCLK1;
  if (HAL_RCCEx_PeriphCLKConfig(&PeriphClkInit) != HAL_OK)
  {
    Error_Handler();
  }

    /**Configure the main internal regulator output voltage 
    */
  if (HAL_PWREx_ControlVoltageScaling(PWR_REGULATOR_VOLTAGE_SCALE1) != HAL_OK)
  {
    Error_Handler();
  }

    /**Configure the Systick interrupt time 
    */
  HAL_SYSTICK_Config(HAL_RCC_GetHCLKFreq()/1000);

    /**Configure the Systick 
    */
  HAL_SYSTICK_CLKSourceConfig(SYSTICK_CLKSOURCE_HCLK);

  /* SysTick_IRQn interrupt configuration */
  HAL_NVIC_SetPriority(SysTick_IRQn, 0, 0);
}

/* I2C3 init function */
static void MX_I2C3_Init(void)
{

  hi2c3.Instance = I2C3;
  hi2c3.Init.Timing = 0x10909CEC;
  hi2c3.Init.OwnAddress1 = 0;
  hi2c3.Init.AddressingMode = I2C_ADDRESSINGMODE_7BIT;
  hi2c3.Init.DualAddressMode = I2C_DUALADDRESS_DISABLE;
  hi2c3.Init.OwnAddress2 = 0;
  hi2c3.Init.OwnAddress2Masks = I2C_OA2_NOMASK;
  hi2c3.Init.GeneralCallMode = I2C_GENERALCALL_DISABLE;
  hi2c3.Init.NoStretchMode = I2C_NOSTRETCH_DISABLE;
  if (HAL_I2C_Init(&hi2c3) != HAL_OK)
  {
    Error_Handler();
  }

    /**Configure Analogue filter 
    */
  if (HAL_I2CEx_ConfigAnalogFilter(&hi2c3, I2C_ANALOGFILTER_ENABLE) != HAL_OK)
  {
    Error_Handler();
  }

}

/** Configure pins as 
        * Analog 
        * Input 
        * Output
        * EVENT_OUT
        * EXTI
     PA2   ------> USART2_TX
     PA3   ------> USART2_RX
*/
static void MX_GPIO_Init(void)
{

  GPIO_InitTypeDef GPIO_InitStruct;

  /* GPIO Ports Clock Enable */
  __HAL_RCC_GPIOC_CLK_ENABLE();
  __HAL_RCC_GPIOH_CLK_ENABLE();
  __HAL_RCC_GPIOA_CLK_ENABLE();
  __HAL_RCC_GPIOB_CLK_ENABLE();

  /*Configure GPIO pin Output Level */
  HAL_GPIO_WritePin(LD2_GPIO_Port, LD2_Pin, GPIO_PIN_RESET);

  /*Configure GPIO pin : B1_Pin */
  GPIO_InitStruct.Pin = B1_Pin;
  GPIO_InitStruct.Mode = GPIO_MODE_IT_FALLING;
  GPIO_InitStruct.Pull = GPIO_NOPULL;
  HAL_GPIO_Init(B1_GPIO_Port, &GPIO_InitStruct);

  /*Configure GPIO pins : USART_TX_Pin USART_RX_Pin */
  GPIO_InitStruct.Pin = USART_TX_Pin|USART_RX_Pin;
  GPIO_InitStruct.Mode = GPIO_MODE_AF_PP;
  GPIO_InitStruct.Pull = GPIO_NOPULL;
  GPIO_InitStruct.Speed = GPIO_SPEED_FREQ_VERY_HIGH;
  GPIO_InitStruct.Alternate = GPIO_AF7_USART2;
  HAL_GPIO_Init(GPIOA, &GPIO_InitStruct);

  /*Configure GPIO pin : LD2_Pin */
  GPIO_InitStruct.Pin = LD2_Pin;
  GPIO_InitStruct.Mode = GPIO_MODE_OUTPUT_PP;
  GPIO_InitStruct.Pull = GPIO_NOPULL;
  GPIO_InitStruct.Speed = GPIO_SPEED_FREQ_LOW;
  HAL_GPIO_Init(LD2_GPIO_Port, &GPIO_InitStruct);

}

/* USER CODE BEGIN 4 */

/* USER CODE END 4 */

/**
  * @brief  This function is executed in case of error occurrence.
  * @param  None
  * @retval None
  */
void Error_Handler(void)
{
  /* USER CODE BEGIN Error_Handler */
  /* User can add his own implementation to report the HAL error return state */
  while(1) 
  {
  }
  /* USER CODE END Error_Handler */ 
}

void LED_Init(void)
{
  GPIO_InitTypeDef  gpioinitstruct = {0};

  /* Enable the GPIO_LED Clock */
  __HAL_RCC_GPIOA_CLK_ENABLE();

  /* Configure the GPIO_LED pin */
  gpioinitstruct.Pin   = GPIO_PIN_4;
  gpioinitstruct.Mode  = GPIO_MODE_OUTPUT_PP;
  gpioinitstruct.Pull  = GPIO_NOPULL;
  gpioinitstruct.Speed = GPIO_SPEED_FREQ_HIGH;
  HAL_GPIO_Init(GPIOA, &gpioinitstruct);
}

void LED_On(void)
{
  HAL_GPIO_WritePin(GPIOA, GPIO_PIN_4, GPIO_PIN_SET);
}

void LED_Off(void)
{
  HAL_GPIO_WritePin(GPIOA, GPIO_PIN_4, GPIO_PIN_RESET);
}

#ifdef USE_FULL_ASSERT

/**
   * @brief Reports the name of the source file and the source line number
   * where the assert_param error has occurred.
   * @param file: pointer to the source file name
   * @param line: assert_param error line source number
   * @retval None
   */
void assert_failed(uint8_t* file, uint32_t line)
{
  /* USER CODE BEGIN 6 */
  /* User can add his own implementation to report the file name and line number,
    ex: printf("Wrong parameters value: file %s on line %d\r\n", file, line) */
  /* USER CODE END 6 */

}

#endif

/**
  * @}
  */ 

/**
  * @}
*/ 

/************************ (C) COPYRIGHT STMicroelectronics *****END OF FILE****/
